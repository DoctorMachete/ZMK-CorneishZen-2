## config/west.yml
```yaml
manifest:
  remotes:
    - name: caksoylar
      url-base: https://github.com/caksoylar
  projects:
    - name: zmk
      remote: caksoylar
      revision: zen-v1+v2+experimental # custom branch name
      import: app/west.yml
  self:
    path: config
```
